## drivers/media/video/utcamera/Kconfig
```kconfig
   
config VIDEO_BF3A20
  tristate "Bf3a20 Mipi Camera Sensor"
  depends on SOC_CAMERA && I2C
  ---help---
    This driver supports Bf3a20 Soc camera module

config VIDEO_OV5645
  tristate "OV5645 Mipi Camera Sensor"
  depends on SOC_CAMERA && I2C
  ---help---
    This driver supports OV5645 Soc camera module

config VIDEO_HM5065
  tristate "HM5065 ITU Camera Sensor"
  depends on SOC_CAMERA && I2C
  ---help---
    This driver supports HM5065 Soc camera module

config VIDEO_GC2035
  tristate "GC2035 ITU Camera Sensor"
  depends on SOC_CAMERA && I2C
  ---help---
    This driver supports GC2035 Soc camera module
```

## drivers/net/wireless/dhd-1.88.10/Kconfig
```kconfig
config DHD_1_88_10
	tristate "Broadcom 4329/30 DHD_1_88_10 wireless cards support"
	depends on MMC
	---help---
	  This module adds support for wireless adapters based on
	  Broadcom 4329/30 chipset.

	  This driver uses the kernel's wireless extensions subsystem.

	  If you choose to build a module, it'll be called dhd. Say M if
	  unsure.

config BCMDHD_FW_PATH
	depends on DHD_1_88_10
	string "Firmware path"
	default "/system/etc/firmware/fw_bcmdhd.bin"
	---help---
	  Path to the firmware file.

config BCMDHD_NVRAM_PATH
	depends on DHD_1_88_10
	string "NVRAM path"
	default "/system/etc/wifi/bcmdhd.cal"
	---help---
	  Path to the calibration file.

config BCMDHD_CONFIG_PATH
	depends on DHD_1_88_10
	string "Config path"
	default "/system/etc/firmware/config.txt"
	---help---
	  Path to the driver configuration file.

config BCMDHD_WEXT
	bool "Enable WEXT support"
	depends on DHD_1_88_10 && CFG80211 = n
	select WIRELESS_EXT
	select WEXT_PRIV
	help
	  Enables WEXT support

##choice
##	depends on DHD_1_88_10
##	prompt "Interrupt type"
##	---help---
##	  Interrupt type
##config BCMDHD_OOB
##	depends on DHD_1_88_10
##	bool "Out-of-Band Interrupt"
##	default y
##	---help---
##	  Interrupt from WL_HOST_WAKE.
##config BCMDHD_SDIO_IRQ
##	depends on  DHD_1_88_10
##	bool "In-Band Interrupt"
##	---help---
##	  Interrupt from SDIO DAT[1]
##	  
##endchoice


config DHD_USE_STATIC_BUF
	bool "Enable memory preallocation"
	depends on DHD_1_88_10
	default n
	---help---
	  Use memory preallocated in platform

config DHD_USE_SCHED_SCAN
	bool "Use CFG80211 sched scan"
	depends on DHD_1_88_10 && CFG80211
	default n
	---help---
	  Use CFG80211 sched scan
```

## drivers/oem_drv/Kconfig
```kconfig
menu "oem_drv customized drivers"
source drivers/oem_drv/nfc/Kconfig
source drivers/oem_drv/touchscreen/Kconfig
source drivers/oem_drv/mtk_wcn_combo/Kconfig
source "drivers/oem_drv/oem_gpio_cfg/Kconfig"

config QN8027_FM	
    bool "QN8027 FM Radio Transmitter Support"
    default n	
    ---help---	  
      If you say Y here, you can use QN8027  

config OEM_BTN	
    bool "Oem Button Support"
    default y	
    ---help---	  
      If you say Y here, you can use oem_btn  

#add by modify for RDA BT module start
config BT_RDA_587X_MODULE_SUPPORT	
    bool "RDA Module 587X Support"
    depends on BT_HCIUART
    default n	
    ---help---	  
      If you say Y here, you can use RDA Module 587X  
#add end

config URBETTER_DOCK_KEYBOARD
	tristate "URBETTER dock keyboard"
	default y
	---help---
		Say Y here if you want to support dock keyboard!
		
config URBETTER_SIM_DETECT
	tristate "URBETTER Sim Detect"
	default y
	---help---
		Say Y here if you want to support dock keyboard!

config URBETTER_POWER_GPIO
	tristate "urbest Power GPIOs"
	default y
	---help---
	  Say Y here if you want to support urbest power GPIO.

menu "oem_drv button driver"
	  
config URBETTER_MID_BUTTON
	tristate "urbest general button driver"
	default n
	---help---
	  Say Y here if you want to support urbest MID button driver.

endmenu

config UT_LIGHTSENSOR_BH1721
	bool "UT light sensor  bh1721"
	default y
	---help---
	  Say Y here if you want to support ut lightsensor driver.

config URBETTER_BATTERY
	tristate "urbest Battery"
	default n
	---help---
	  Say Y here if you want to support urbest battery driver.

config URBETTER_MOTOR_SHAKE
	bool "urbest Motor Shake for smdk4x12"
	default y
	---help---
	  Say Y here if you want to support urbest motor driver.

config URBETTER_GSENEOR_MMA7660
	tristate "urbest 3-Axis G sensor"
	default n
	---help---
	  Say Y here if you want to support urbest 3-Axis G sensor.

choice
depends on URBETTER_GSENEOR_MMA7660
prompt "Select direction(board)"
default MMA7660_UT7GM

config MMA7660_UT7GM
	bool "UT7GM direction"
	---help---
	  select the sensor direction for UT7GM

config MMA7660_UT10GM
	bool "UT10GM direction"
	---help---
	  select the sensor direction for UT10GM

config MMA7660_DEFAULT
	bool "default direction"
	---help---
	  select the sensor direction for default

endchoice	

	  
config URBETTER_REGWATCH
	tristate "urbest register watcher(read/write physical register for debug)"
	default y
	---help---
	  Say Y here if you want to support urbest register watcher(read/write physical register for debug).

config URBETTER_DISPLAY_CONTROLLER
	tristate "urbest display controller(Gamma/Hue/Color gain)"
	default y
	---help---
	  Say Y here if you want to support urbest display controller(Gamma/Hue/Color gain).

endmenu
```

## drivers/oem_drv/nfc/Kconfig
```kconfig
#
# pn544 devices
#

menuconfig PN544_DEVICES
	bool "pn544 devices"
	default y
	---help---
	  Say Y here to get to see options for device drivers from various
	  different categories. This option alone does not add any kernel code.

	  If you say N, all options in this submenu will be skipped and disabled.

if PN544_DEVICES

config PN544
	tristate "NXP PN544 NFC Controller Driver"
	depends on I2C
	default n
	help
	  NXP PN544 Near Field Communication controller support.


endif # PN544_DEVICES


config BCM2079X_I2C
    tristate "BCM2079X_I2C nfc support"
    depends on I2C
    default n
    help
      If you say yes here you get support for BCM2079x_I2C support
```

## drivers/oem_drv/oem_gpio_cfg/Kconfig
```kconfig
menu "oem gpio cfg drivers"

config OEM_GPIO_CFG
	tristate "oem gpio config"
	default y
	---help---
	  oem gpio coutrol
	  
config S706_GPIO_CFG
	tristate "s706 gpio config"
	depends on OEM_GPIO_CFG
	---help---
	  s706 gpio coutrol

config D105_GPIO_CFG
	tristate "D105 gpio config"
	depends on OEM_GPIO_CFG
	---help---
	  D105 gpio coutrol

config S502_GPIO_CFG
	tristate "s502 gpio config"
	depends on OEM_GPIO_CFG
	---help---
	  s502 gpio coutrol

config S106_GPIO_CFG
	tristate "s106 gpio config"
	depends on OEM_GPIO_CFG
	---help---
	  s106 gpio coutrol
	  
config D720_GPIO_CFG
	tristate "d720 gpio config"
	depends on OEM_GPIO_CFG
	---help---
	  d720  gpio coutrol

endmenu
```

## drivers/oem_drv/power_gpio/Kconfig
```kconfig
menu "power gpio drivers"

config URBETTER_POWER_GPIO	
    bool "Urbetter Power Gpio Driver Support"
    default y	
    ---help---	  
      If you say Y here, you can use power_gpio  

config POWER_GPIO_D720_V1	
    bool "Power Gpio Driver for D720 V1"
    depends on URBETTER_POWER_GPIO
    default y	
    ---help---	  
      If you say Y here, you can use power_gpio for d720 v1  

config POWER_GPIO_D720_V4	
    bool "Power Gpio Driver for D720 V4"
    depends on URBETTER_POWER_GPIO
    default y	
    ---help---	  
      If you say Y here, you can use power_gpio for d720 v4  

config POWER_GPIO_S106	
    bool "Power Gpio Driver for S106"
    depends on URBETTER_POWER_GPIO
    default y	
    ---help---	  
      If you say Y here, you can use power_gpio for S106  	

config POWER_GPIO_D1011	
    bool "Power Gpio Driver for D1011"
    depends on URBETTER_POWER_GPIO
    default y	
    ---help---	  
      If you say Y here, you can use power_gpio for D1011 

endmenu
```

## drivers/oem_drv/touchscreen/Kconfig
```kconfig
#
# Touchscreen driver configuration
#
menuconfig INPUT_TOUCHSCREEN
	bool "Touchscreens"
	help
	  Say Y here, and a list of supported touchscreens will be displayed.
	  This option doesn't affect the kernel.

	  If unsure, say Y.

if INPUT_TOUCHSCREEN
            
  config TOUCHSCREEN_4212_105N 
	tristate "Goodix 4212 TouchScreen Driver"
	default y
	depends on I2C
	help
	  It is a android driver to support Gooidx's touchscreen whose name
	  is guitar on s3cxxxx platform. The touchscreen can support multi-touch
	  not more than two fingers.

	  Say Y here to enable the driver for the touchscreen on the
	  S3C SMDK board.

	  If unsure, say N.To compile this driver as a module, choose M here:
	  the module will be called goodix_touch_gt801_plus.ko.


config TOUCHSCREEN_NOVATEK_4X12_105N
        tristate "touchscreen driver  Novatek  4X12 105n"
         default n
        depends on I2C
  
        
config TOUCHSCREEN_FT5X0X_105
        tristate "touchscreen driver  FT5X0X 105"
#	depends on TOUCHSCREEN_S3C
        default m
        help
          Say Y here to enable the driver for the touchscreen on the
          S3C SMDK board.

          If unsure, say N.

          To compile this driver as a module, choose M here: the
          module will be called s3c_ts.

 config TOUCHSCREEN_FT5X0X_5406
        tristate "touchscreen driver  FT5X0X 5406"
#	depends on TOUCHSCREEN_S3C
        default m
        help
          Say Y here to enable the driver for the touchscreen on the
          S3C SMDK board.

          If unsure, say N.

          To compile this driver as a module, choose M here: the
          module will be called s3c_ts.

 config TOUCHSCREEN_UC
        tristate "touchscreen driver  UC"
#	depends on TOUCHSCREEN_S3C
        default m
        help
          Say Y here to enable the driver for the touchscreen on the
          S3C SMDK board.

          If unsure, say N.

          To compile this driver as a module, choose M here: the
          module will be called s3c_ts.
          
 config TOUCHSCREEN_GSLX680
        tristate "touchscreen driver  gslx680 for s702"
#	depends on TOUCHSCREEN_S3C
        default m
        help
          Say Y here to enable the driver for the touchscreen on the
          S3C SMDK board.

          If unsure, say N.

          To compile this driver as a module, choose M here: the
          module will be called s3c_ts.
          

 config TOUCHSCREEN_FT5X0X_5506
        tristate "touchscreen driver  FT5X0X 5506"
#	depends on TOUCHSCREEN_S3C
        default m
        help
          Say Y here to enable the driver for the touchscreen on the
          S3C SMDK board.

          If unsure, say N.

          To compile this driver as a module, choose M here: the
          module will be called s3c_ts.

   config TOUCHSCREEN_GT813_827_828
        tristate "touchscreen driver  GT813_827_828"
#	depends on TOUCHSCREEN_S3C
        default m
        help
          Say Y here to enable the driver for the touchscreen on the
          S3C SMDK board.

          If unsure, say N.

          To compile this driver as a module, choose M here: the
          module will be called s3c_ts.

config TOUCHSCREEN_GT9XX
        tristate "touchscreen driver  GT9XX"
        default y
        help
          Say Y here to enable the driver for the touchscreen on the
          S3C SMDK board.

          If unsure, say N.

          To compile this driver as a module, choose M here: the
          module will be called s3c_ts.


config TOUCHSCREEN_VTL_CT36X
        tristate "TOUCHSCREEN_VTL_CT36X"
        default n
        help
          Say Y here to enable the driver for the touchscreen on the
          S3C SMDK board.

          If unsure, say N.

          To compile this driver as a module, choose M here: the
          module will be called s3c_ts.
       
endif
```

## drivers/switch/Kconfig
```kconfig
menuconfig SWITCH
	tristate "Switch class support"
	help
	  Say Y here to enable switch class support. This allows
	  monitoring switches by userspace via sysfs and uevent.

if SWITCH

config SWITCH_GPIO
	tristate "GPIO Swith support"
	depends on GENERIC_GPIO
	help
	  Say Y here to enable GPIO based switch support.

config SWITCH_4212_HEADSET
	bool "4212 Headset Detect"
	depends on SWITCH_GPIO 

config SWITCH_4212_3GMicSw
  bool "4212 Headset Detect by 3G_MIC_SW 2013/01/12 for factory 2K Pics"
endif # SWITCH
```
